## config/west.yml
```yaml
manifest:
  remotes:
    - name: zmkfirmware
      url-base: https://github.com/zmkfirmware
    - name: ShiniNet
      url-base: https://github.com/ShiniNet
    - name: caksoylar
      url-base: https://github.com/caksoylar
    - name: badjeff
      url-base: https://github.com/badjeff
    - name: ssbb
      url-base: https://github.com/ssbb
    - name: urob
      url-base: https://github.com/urob
    - name: kot149
      url-base: https://github.com/kot149
    - name: amgskobo
      url-base: https://github.com/amgskobo
    - name: BP
      url-base: https://github.com/taichan1113
  projects:
    # https://github.com/zmkfirmware/zmk
    - name: zmk
      remote: zmkfirmware
      revision: edf5c0814fd3ea202e43aad2d68fd32e882a518c # v0.3.0
      import: app/west.yml

    # https://github.com/ShiniNet/zmk-driver-iqs9151
    - name: zmk-driver-iqs9151
      remote: kot149
      revision: af9c4e3501eb72dcc30c282a078fc600c567d62e # feat/stop-scroll-inertia-on-modifier-press (2026-11-23)
      path: modules/zmk-driver-iqs9151

    # https://github.com/ShiniNet/zmk-easy-charge-indicator
    - name: zmk-easy-charge-indicator
      remote: ShiniNet
      revision: 8f23ef9faaf379f00c6ee0441a9e730d35663069 # main (2026-11-23)
      path: modules/zmk-easy-charge-indicator

    # https://github.com/caksoylar/zmk-rgbled-widget
    - name: zmk-rgbled-widget
      remote: caksoylar
      revision: 8756cb7b8114069fa3c25c6f6c990f24988fceff # v0.3
      path: modules/zmk-rgbled-widget

    # https://github.com/badjeff/zmk-input-processor-report-rate-limit
    - name: zmk-input-processor-report-rate-limit
      remote: badjeff
      revision: f43f37aae7aaa7bf0ec4d432683b873a7e3a8efa # for v0.3-branch
      path: modules/zmk-input-processor-report-rate-limit

    # https://github.com/ssbb/zmk-listeners
    - name: zmk-listeners
      remote: ssbb
      revision: c240ceaf353d3138bea7695eef17049b7ade995b # v1 (2026-11-23)
      path: modules/zmk-listeners
    # https://github.com/caksoylar/zmk-smart-toggle
    - name: zmk-smart-toggle
      remote: caksoylar
      revision: 46e178221cccef965a511b772d7bc62800f1542e
      path: modules/zmk-smart-toggle

    # https://github.com/urob/zmk-adaptive-key
    - name: zmk-adaptive-key
      remote: urob
      revision: 01ccc22889714f276c930dc960a989f80c9e0680
      path: modules/zmk-adaptive-key


    # https://github.com/kot149/zmk-mouse-gesture
    - name: zmk-mouse-gesture
      remote: kot149
      revision: 5d80b4489fe6f22d6677984d72d445b5190ef36f # v2
      path: modules/zmk-mouse-gesture

    # https://github.com/kot149/zmk-layout-shift
    - name: zmk-layout-shift
      remote: kot149
      revision: c242c13c9c5a6100b3980b8c725c734c368670de # v2
      path: modules/zmk-layout-shift

    # https://github.com/kot149/zmk-scroll-snap
    - name: zmk-scroll-snap
      remote: kot149
      revision: 6b2dccaab2d5b99ca8b79300b9a792fefb01c42d # v1 (2026-11-23)
      path: modules/zmk-scroll-snap

    # https://github.com/kot149/zmk-input-inertia
    - name: zmk-input-inertia
      remote: kot149
      revision: 43e874d9ddc0b6fc0d1ac6163c2164ba2b55fef0 # v0.3-branch (2026-11-23)
      path: modules/zmk-input-inertia

    # https://github.com/taichan1113/zmk-behavior-quick-scroll
    - name: zmk-behavior-quick-scroll
      remote: BP
      revision: aa679aa4aa51cb9c0d2281cf34567e9325a0333a # main (2026-11-23)
      path: modules/zmk-behavior-quick-scroll
  self:
    path: config
```
